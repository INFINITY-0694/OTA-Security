## main/Kconfig.projbuild
```kconfig
menu "Secure OTA project settings"

config OTA_WIFI_SSID
    string "Wi-Fi SSID"
    default "YOUR_WIFI_SSID"
    help
        SSID of the Wi-Fi network used by the physical ESP32.

config OTA_WIFI_PASSWORD
    string "Wi-Fi password"
    default "YOUR_WIFI_PASSWORD"
    help
        Password of the Wi-Fi network used by the physical ESP32.

config OTA_VERSION_URL
    string "OTA version server URL"
    default "https://ota.divysoni.me/version"
    help
        HTTPS version URL served from the production OTA domain.

config OTA_MANIFEST_URL
    string "OTA signed manifest URL"
    default "https://ota.divysoni.me/manifest"
    help
        HTTPS signed manifest URL served from the production OTA domain.

config OTA_FIRMWARE_URL
    string "OTA firmware URL"
    default "https://ota.divysoni.me/update"
    help
        HTTPS encrypted firmware URL served from the production OTA domain.

config OTA_FACTORY_AES_KEY_HEX
    string "Factory AES-256 key (initial USB provisioning only)"
    default ""
    help
        Optional 64-hex-character key used once to seed NVS on the factory USB image.
        Leave empty in all later OTA builds. Never commit this value.

endmenu
```
